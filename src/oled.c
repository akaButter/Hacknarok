#include "oled.h"
#include <zephyr/kernel.h>

#define oled_ADDR 0x3C

static const struct device *i2c_dev;

static const uint8_t font5x7[][5] = {

    {0x3E,0x51,0x49,0x45,0x3E}, // 0
    {0x00,0x42,0x7F,0x40,0x00}, // 1
    {0x42,0x61,0x51,0x49,0x46}, // 2
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    {0x08, 0x08, 0x08, 0x08, 0x08} // -
};

static const uint8_t* get_char(char c)
{
    if (c >= '0' && c <= '9')
        return font5x7[c - '0'];

    if (c >= 'A' && c <= 'Z')
        return font5x7[10 + (c - 'A')];

    if (c >= 'a' && c <= 'z')
        return font5x7[10 + (c - 'a')];

    if (c == '-') return font5x7[37]; 

    return font5x7[36];
}

static int cmd(uint8_t c)
{
    uint8_t b[2] = {0x00, c};
    return i2c_write(i2c_dev, b, 2, oled_ADDR);
}

static int data(uint8_t *d, size_t len)
{
    uint8_t buf[129];
    buf[0] = 0x40;

    for (size_t i = 0; i < len; i++)
        buf[i + 1] = d[i];

    return i2c_write(i2c_dev, buf, len + 1, oled_ADDR);
}

static void oled_hw_init(void)
{
    k_msleep(100);

    cmd(0xAE);
    cmd(0x20); cmd(0x00);
    cmd(0xB0);
    cmd(0xC8);
    cmd(0x81); cmd(0x7F);
    cmd(0xA1);
    cmd(0xA6);
    cmd(0xA8); cmd(0x3F);
    cmd(0xD5); cmd(0x80);
    cmd(0xD9); cmd(0xF1);
    cmd(0xDA); cmd(0x12);
    cmd(0xDB); cmd(0x40);
    cmd(0x8D); cmd(0x14);
    cmd(0xAF);
}

static void set_pos(uint8_t page, uint8_t col)
{
    cmd(0xB0 + page);
    cmd(0x00 + (col & 0x0F));
    cmd(0x10 + (col >> 4));
}

static void draw_text_line(uint8_t page, const char *s)
{
    uint8_t buf[128] = {0};
    int x = 0;

    while (*s && x < 120) {
        const uint8_t *ch = get_char(*s);

        for (int i = 0; i < 5; i++)
            buf[x++] = ch[i];

        buf[x++] = 0x00;
        s++;
    }

    set_pos(page, 0);
    data(buf, 128);
}


int oled_init(const struct device *dev)
{
    i2c_dev = dev;

    if (!device_is_ready(i2c_dev))
        return -1;

    oled_hw_init();
    return 0;
}

void oled_clear(void)
{
    uint8_t blank[128] = {0};

    for (int page = 0; page < 8; page++) {
        set_pos(page, 0);
        data(blank, 128);
    }
}

void oled_write_line(uint8_t page, const char *text)
{
    draw_text_line(page, text);
}

void oled_write(const char *text)
{
    draw_text_line(0, text);
}